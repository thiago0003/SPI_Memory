//#include <zephyr.h>
#include <zephyr/drivers/gpio.h>

#define MAX_LINE_BYTES 16// =128/8
#define MAX_COLUMN_BYTES  250

#define ALLSCREEN_GRAGHBYTES  4000

#define HIGH 1
#define LOW 0

static const struct gpio_dt_spec BUSY = GPIO_DT_SPEC_GET(DT_NODELABEL(busypin), gpios);
static const struct gpio_dt_spec RES = GPIO_DT_SPEC_GET(DT_NODELABEL(respin), gpios);
static const struct gpio_dt_spec DC = GPIO_DT_SPEC_GET(DT_NODELABEL(dcpin), gpios);
static const struct gpio_dt_spec CS = GPIO_DT_SPEC_GET(DT_NODELABEL(cspin), gpios);
static const struct gpio_dt_spec SCK = GPIO_DT_SPEC_GET(DT_NODELABEL(sckpin), gpios);
static const struct gpio_dt_spec SDI = GPIO_DT_SPEC_GET(DT_NODELABEL(sdipin), gpios);
static const struct gpio_dt_spec EPEN = GPIO_DT_SPEC_GET(DT_NODELABEL(epenpin), gpios);
static const struct gpio_dt_spec LED0 = GPIO_DT_SPEC_GET(DT_NODELABEL(ledpin), gpios);
static const struct gpio_dt_spec LED1 = GPIO_DT_SPEC_GET(DT_NODELABEL(ledpin0), gpios);
static const struct gpio_dt_spec LED2 = GPIO_DT_SPEC_GET(DT_NODELABEL(ledpin1), gpios);

////////FUNCTION//////
void driver_delay_us(unsigned int xus);
void driver_delay_xms(unsigned long xms);
void DELAY_S(unsigned int delaytime);     
void SPI_Delay(unsigned char xrate);
void SPI_Write(unsigned char value);
void Epaper_Write_Command(unsigned char command);
void Epaper_Write_Data(unsigned char command);

//EPD
void Epaper_READBUSY(void);
void EPD_HW_Init(void); //Electronic paper initialization
void EPD_Update(void);
void epaperSetup();

void EPD_WhiteScreen_Black(void);
void EPD_WhiteScreen_White(void);
void EPD_DeepSleep(void);

//Display 
void EPD_WhiteScreen_ALL(const unsigned char *BW_datas,const unsigned char *R_datas);
void EPD_WhiteScreen_ALL_Clean(void);
void updateWhiteColumn(char column, const unsigned char *data, char length);
void updateRedColumn(char column, const unsigned char *data, char length);
void updateDisplay();
void cleanDisplay();

unsigned char gImage_BW[ALLSCREEN_GRAGHBYTES] = { /* 0X01,0X01,0XFA,0X00,0X7A,0X00, */
  0xFF, 0xFF, 0xFF, 0xFF, 0xFF, 0xFF, 0xFF, 0xFF, 0xFF, 0xFF, 0xFF, 0xFF,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 0xFF,
};

unsigned char gImage_R[ALLSCREEN_GRAGHBYTES] = { /* 0X01,0X01,0XFA,0X00,0X7A,0X00, */
  0xFF, 0xFF, 0xFF, 0xFF, 0xFF, 0xFF, 0xFF, 0xFF, 0xFF, 0xFF, 0xFF, 0xFF,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 0x00,
};

void driver_delay_us(unsigned int xus)  //1us
{
  for(;xus>1;xus--);
}

void driver_delay_xms(unsigned long xms) //1ms
{  
    unsigned long i = 0 , j=0;

    for(j=0;j<xms;j++)
  {
        for(i=0; i<256; i++);
    }
}

void DELAY_S(unsigned int delaytime)     
{
  int i,j,k;
  for(i=0;i<delaytime;i++)
  {
    for(j=0;j<4000;j++)           
    {
      for(k=0;k<222;k++);
                
    }
  }
}
//////////////////////SPI///////////////////////////////////

void SPI_Delay(unsigned char xrate)
{
  unsigned char i;
  while(xrate)
  {
    for(i=0;i<2;i++);
    xrate--;
  }
}

void SPI_Write(unsigned char value)                                    
{                                                           
	unsigned char i;  
  SPI_Delay(1);
    
	for(i=0; i < 8; i++)   
    {
		  gpio_pin_set_dt(&SCK, LOW);

    	SPI_Delay(1);
    	if(value & 0x80)
			  gpio_pin_set_dt(&SDI, HIGH); //EPD_W21_MOSI_1;
      else
			  gpio_pin_set_dt(&SDI, LOW); //EPD_W21_MOSI_0;
        
		  value = (value << 1); 
    	
		  SPI_Delay(1);
		  driver_delay_us(1);
  
		  gpio_pin_set_dt(&SCK, HIGH); //EPD_W21_CLK_1;
        
		  SPI_Delay(1);
    }
}

void Epaper_Write_Command(unsigned char command)
{
	SPI_Delay(1);

	gpio_pin_set_dt(&CS, LOW);

	gpio_pin_set_dt(&DC, LOW); // command write

	SPI_Write(command);
	
	gpio_pin_set_dt(&CS, HIGH);

}

void Epaper_Write_Data(unsigned char command)
{
  SPI_Delay(1);
            
  gpio_pin_set_dt(&CS, LOW);

  gpio_pin_set_dt(&DC, HIGH); // command write
  
  SPI_Write(command);
  
  gpio_pin_set_dt(&CS, HIGH);

}

//SSD1680
void EPD_HW_Init(void)
{
  gpio_pin_set_dt(&RES, LOW); // Module reset

  k_msleep(10); //At least 10ms delay 
  
  gpio_pin_set_dt(&RES, HIGH);
  
  k_msleep(10); //At least 10ms delay  
    
  Epaper_READBUSY();    

  Epaper_Write_Command(0x12);  //SWRESET
  Epaper_READBUSY();   
    
  Epaper_Write_Command(0x01); //Driver output control      
  Epaper_Write_Data(0xF9);
  Epaper_Write_Data(0x00);
  Epaper_Write_Data(0x00);

  Epaper_Write_Command(0x11); //data entry mode       
  Epaper_Write_Data(0x01);

  Epaper_Write_Command(0x44); //set Ram-X address start/end position   
  Epaper_Write_Data(0x00);
  Epaper_Write_Data(0x0F);    //0x0F-->(15+1)*8=128

  Epaper_Write_Command(0x45); //set Ram-Y address start/end position          
  Epaper_Write_Data(0xF9);   //0xF9-->(249+1)=250
  Epaper_Write_Data(0x00);
  Epaper_Write_Data(0x00);
  Epaper_Write_Data(0x00); 

  Epaper_Write_Command(0x3C); //BorderWavefrom
  Epaper_Write_Data(0x05);  
      
  Epaper_Write_Command(0x18); //Read built-in temperature sensor
  Epaper_Write_Data(0x80);  
  
  Epaper_Write_Command(0x21); //  Display update control
  Epaper_Write_Data(0x00);  
  Epaper_Write_Data(0x80);  

  Epaper_Write_Command(0x4E);   // set RAM x address count to 0;
  Epaper_Write_Data(0x00);
  Epaper_Write_Command(0x4F);   // set RAM y address count to 0X199;    
  Epaper_Write_Data(0xF9);
  Epaper_Write_Data(0x00);

  Epaper_READBUSY();
  
}

void EPD_WhiteScreen_ALL(const unsigned char *BW_datas,const unsigned char *R_datas)
{
  unsigned int i;  

  //Color black
  Epaper_Write_Command(0x24);   //write RAM for black(0)/white (1)
  for(i=0;i<ALLSCREEN_GRAGHBYTES;i++)
  {      
    Epaper_Write_Data(*BW_datas);
    BW_datas ++;
  }

  //Color red
  Epaper_Write_Command(0x26);   //write RAM for black(0)/white (1)
  for(i=0;i<ALLSCREEN_GRAGHBYTES;i++)
  {            
    Epaper_Write_Data(~(*R_datas));
    R_datas ++;
  }
  EPD_Update();   
}

void EPD_WhiteScreen_ALL_Clean(void)
{
    unsigned int i;  
    Epaper_Write_Command(0x24);   //write RAM for black(0)/white (1)
    for(i=0;i<ALLSCREEN_GRAGHBYTES;i++)
    {               
      Epaper_Write_Data(0xff);
    }

  Epaper_Write_Command(0x26);   //write RAM for black(0)/white (1)
   for(i=0;i<ALLSCREEN_GRAGHBYTES;i++)
   {               
     Epaper_Write_Data(0x00);
   }
   EPD_Update();   
}

/////////////////////////////////////////////////////////////////////////////////////////
void EPD_Update(void)
{
  Epaper_Write_Command(0x22); //Display Update Control
  Epaper_Write_Data(0xF7);   
  Epaper_Write_Command(0x20);  //Activate Display Update Sequence
  Epaper_READBUSY();   

}

void EPD_DeepSleep(void)
{  
  Epaper_Write_Command(0x10); //enter deep sleep
  Epaper_Write_Data(0x01); 
  k_msleep(100);
}

void Epaper_READBUSY(void)
{ 
  while(1)
  { 
    if(gpio_pin_get_dt(&BUSY) == 0)
      break;;
  }  
}

void epaperSetup()
{
  gpio_pin_configure_dt(&BUSY, GPIO_INPUT | GPIO_ACTIVE_HIGH);
  gpio_pin_configure_dt(&RES, GPIO_OUTPUT);
  gpio_pin_configure_dt(&DC, GPIO_OUTPUT);
  gpio_pin_configure_dt(&CS, GPIO_OUTPUT);
  gpio_pin_configure_dt(&SCK, GPIO_OUTPUT);
  gpio_pin_configure_dt(&SDI, GPIO_OUTPUT);
  gpio_pin_configure_dt(&EPEN, GPIO_OUTPUT);

  gpio_pin_configure_dt(&LED0, GPIO_OUTPUT | GPIO_ACTIVE_LOW);
  gpio_pin_configure_dt(&LED1, GPIO_OUTPUT | GPIO_ACTIVE_LOW);
  gpio_pin_configure_dt(&LED2, GPIO_OUTPUT | GPIO_ACTIVE_LOW);

  gpio_pin_set_dt(&LED0, 0);
  gpio_pin_set_dt(&LED1, 0);
  gpio_pin_set_dt(&LED2, 0);
}

void updateWhiteColumn(char column, const unsigned char *data, char length)
{
  for (int i = column * MAX_LINE_BYTES, j = 0; i < ALLSCREEN_GRAGHBYTES && j < length; i++, j++)
    gImage_BW[i] = data[j];
}

void updateRedColumn(char column, const unsigned char *data, char length)
{
  for (int i = column * MAX_LINE_BYTES, j = 0; i < ALLSCREEN_GRAGHBYTES && j < length; i++, j++)
    gImage_R[i] = data[j];
}

void updateDisplay()
{
  epaperSetup();

	gpio_pin_set_dt(&EPEN, HIGH);

	EPD_HW_Init(); // Electronic paper initialization  

	EPD_WhiteScreen_ALL(gImage_BW, gImage_R); // Refresh the picture in full screen
	EPD_DeepSleep(); // Enter deep sleep,Sleep instruction is necessary, please do not delete!!!
	
  gpio_pin_set_dt(&EPEN, LOW);
}

void cleanDisplay()
{
  epaperSetup();

  gpio_pin_set_dt(&EPEN, HIGH);

  EPD_HW_Init(); // Electronic paper initialization

  EPD_WhiteScreen_ALL_Clean();
  EPD_DeepSleep(); // Enter deep sleep,Sleep instruction is necessary, please do not delete!!!

  gpio_pin_set_dt(&EPEN, LOW);
}